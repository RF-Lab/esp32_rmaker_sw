## deep_clean_station/main/Kconfig.projbuild
```kconfig
menu "Sensors configuration"

    config TEMP_SENSOR_GPIO
        int "Temperature Sensor GPIO"
        default 4
        help
            Temperature Sensor GPIO.

endmenu
```
